## bpif3_opensbi.its
```
/dts-v1/;

/ {
  description = "ACT4 runner firmware for BPI-F3 (SpacemiT K1), replaces the opensbi FIT slot";
  #address-cells = <1>;

  images {
    firmware {
      description = "bpif3-act4-runner";
      data = /incbin/("firmware_act.bin");
      type = "firmware";
      arch = "riscv";
      os = "opensbi";
      compression = "none";
      load = <0xC0000000>;
      entry = <0xC0000000>;
      hash-1 {
        algo = "crc32";
      };
    };
  };

  configurations {
    default = "config-1";
    config-1 {
      description = "ACT4 runner config";
      firmware = "firmware";
    };
  };
};
```
